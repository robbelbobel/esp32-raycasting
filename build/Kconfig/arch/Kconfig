## build/Kconfig/arch/Kconfig
```kconfig
# Load Zephyr Arch Kconfig descriptions.
osource "/Users/robbetiteca/projects/zephyr-workspace/zephyr/arch/tricore/Kconfig"
osource "/Users/robbetiteca/projects/zephyr-workspace/zephyr/arch/hexagon/Kconfig"
osource "/Users/robbetiteca/projects/zephyr-workspace/zephyr/arch/rx/Kconfig"
osource "/Users/robbetiteca/projects/zephyr-workspace/zephyr/arch/x86/Kconfig"
osource "/Users/robbetiteca/projects/zephyr-workspace/zephyr/arch/xtensa/Kconfig"
osource "/Users/robbetiteca/projects/zephyr-workspace/zephyr/arch/sparc/Kconfig"
osource "/Users/robbetiteca/projects/zephyr-workspace/zephyr/arch/riscv/Kconfig"
osource "/Users/robbetiteca/projects/zephyr-workspace/zephyr/arch/posix/Kconfig"
osource "/Users/robbetiteca/projects/zephyr-workspace/zephyr/arch/openrisc/Kconfig"
osource "/Users/robbetiteca/projects/zephyr-workspace/zephyr/arch/mips/Kconfig"
osource "/Users/robbetiteca/projects/zephyr-workspace/zephyr/arch/arm64/Kconfig"
osource "/Users/robbetiteca/projects/zephyr-workspace/zephyr/arch/arm/Kconfig"
osource "/Users/robbetiteca/projects/zephyr-workspace/zephyr/arch/arc/Kconfig"
```

## build/Kconfig/boards/Kconfig
```kconfig
# Load Zephyr board Kconfig descriptions.
osource "/Users/robbetiteca/projects/zephyr-workspace/zephyr/boards/espressif/esp32s3_devkitc/Kconfig"
```

## build/Kconfig/boards/Kconfig.defconfig
```kconfig
# Load Zephyr board defconfig descriptions.
osource "/Users/robbetiteca/projects/zephyr-workspace/zephyr/boards/espressif/esp32s3_devkitc/Kconfig.defconfig"
```

## build/Kconfig/boards/Kconfig.esp32s3_devkitc
```kconfig
# Load board Kconfig descriptions.
osource "/Users/robbetiteca/projects/zephyr-workspace/zephyr/boards/espressif/esp32s3_devkitc/Kconfig.esp32s3_devkitc"
```

## build/Kconfig/soc/Kconfig
```kconfig
# Load Zephyr SoC Kconfig descriptions.
osource "/Users/robbetiteca/projects/zephyr-workspace/zephyr/soc/xlnx/zynqmp/Kconfig"
osource "/Users/robbetiteca/projects/zephyr-workspace/zephyr/soc/xlnx/zynq7000/Kconfig"
osource "/Users/robbetiteca/projects/zephyr-workspace/zephyr/soc/xlnx/versalnet/Kconfig"
osource "/Users/robbetiteca/projects/zephyr-workspace/zephyr/soc/xlnx/versal2/Kconfig"
osource "/Users/robbetiteca/projects/zephyr-workspace/zephyr/soc/xlnx/versal/Kconfig"
osource "/Users/robbetiteca/projects/zephyr-workspace/zephyr/soc/xen/Kconfig"
osource "/Users/robbetiteca/projects/zephyr-workspace/zephyr/soc/wch/ch32v/Kconfig"
osource "/Users/robbetiteca/projects/zephyr-workspace/zephyr/soc/ti/tiva_c/Kconfig"
osource "/Users/robbetiteca/projects/zephyr-workspace/zephyr/soc/ti/simplelink/Kconfig"
osource "/Users/robbetiteca/projects/zephyr-workspace/zephyr/soc/ti/mspm/Kconfig"
osource "/Users/robbetiteca/projects/zephyr-workspace/zephyr/soc/ti/lm3s6965/Kconfig"
osource "/Users/robbetiteca/projects/zephyr-workspace/zephyr/soc/ti/k3/Kconfig"
osource "/Users/robbetiteca/projects/zephyr-workspace/zephyr/soc/ti/am13/Kconfig"
osource "/Users/robbetiteca/projects/zephyr-workspace/zephyr/soc/telink/tlsr/Kconfig"
osource "/Users/robbetiteca/projects/zephyr-workspace/zephyr/soc/syna/sr100/Kconfig"
osource "/Users/robbetiteca/projects/zephyr-workspace/zephyr/soc/starfive/jh71xx/Kconfig"
osource "/Users/robbetiteca/projects/zephyr-workspace/zephyr/soc/st/stm32/Kconfig"
osource "/Users/robbetiteca/projects/zephyr-workspace/zephyr/soc/snps/qemu_arc/Kconfig"
osource "/Users/robbetiteca/projects/zephyr-workspace/zephyr/soc/snps/nsim/arc_v/Kconfig"
osource "/Users/robbetiteca/projects/zephyr-workspace/zephyr/soc/snps/nsim/arc_classic/Kconfig"
osource "/Users/robbetiteca/projects/zephyr-workspace/zephyr/soc/snps/hsdk4xd/Kconfig"
osource "/Users/robbetiteca/projects/zephyr-workspace/zephyr/soc/snps/hsdk/Kconfig"
osource "/Users/robbetiteca/projects/zephyr-workspace/zephyr/soc/snps/emsk/Kconfig"
osource "/Users/robbetiteca/projects/zephyr-workspace/zephyr/soc/snps/emsdp/Kconfig"
osource "/Users/robbetiteca/projects/zephyr-workspace/zephyr/soc/snps/arc_iot/Kconfig"
osource "/Users/robbetiteca/projects/zephyr-workspace/zephyr/soc/silabs/Kconfig"
osource "/Users/robbetiteca/projects/zephyr-workspace/zephyr/soc/sifli/sf32/Kconfig"
osource "/Users/robbetiteca/projects/zephyr-workspace/zephyr/soc/sifive/sifive_freedom/Kconfig"
osource "/Users/robbetiteca/projects/zephyr-workspace/zephyr/soc/shakti/Kconfig"
osource "/Users/robbetiteca/projects/zephyr-workspace/zephyr/soc/sensry/Kconfig"
osource "/Users/robbetiteca/projects/zephyr-workspace/zephyr/soc/rockchip/Kconfig"
osource "/Users/robbetiteca/projects/zephyr-workspace/zephyr/soc/renode/riscv_virtual/Kconfig"
osource "/Users/robbetiteca/projects/zephyr-workspace/zephyr/soc/renode/cortex_r8_virtual/Kconfig"
osource "/Users/robbetiteca/projects/zephyr-workspace/zephyr/soc/renesas/smartbond/Kconfig"
osource "/Users/robbetiteca/projects/zephyr-workspace/zephyr/soc/renesas/rz/Kconfig"
osource "/Users/robbetiteca/projects/zephyr-workspace/zephyr/soc/renesas/rx/Kconfig"
osource "/Users/robbetiteca/projects/zephyr-workspace/zephyr/soc/renesas/rcar/Kconfig"
osource "/Users/robbetiteca/projects/zephyr-workspace/zephyr/soc/renesas/ra/Kconfig"
osource "/Users/robbetiteca/projects/zephyr-workspace/zephyr/soc/realtek/fingerprint/Kconfig"
osource "/Users/robbetiteca/projects/zephyr-workspace/zephyr/soc/realtek/ec/Kconfig"
osource "/Users/robbetiteca/projects/zephyr-workspace/zephyr/soc/realtek/bee/Kconfig"
osource "/Users/robbetiteca/projects/zephyr-workspace/zephyr/soc/realtek/ameba/Kconfig"
osource "/Users/robbetiteca/projects/zephyr-workspace/zephyr/soc/raspberrypi/rpi_pico/Kconfig"
osource "/Users/robbetiteca/projects/zephyr-workspace/zephyr/soc/quicklogic/eos_s3/Kconfig"
osource "/Users/robbetiteca/projects/zephyr-workspace/zephyr/soc/qemu/virt_riscv/Kconfig"
osource "/Users/robbetiteca/projects/zephyr-workspace/zephyr/soc/qemu/tricore/Kconfig"
osource "/Users/robbetiteca/projects/zephyr-workspace/zephyr/soc/qemu/or1k/Kconfig"
osource "/Users/robbetiteca/projects/zephyr-workspace/zephyr/soc/qemu/malta/Kconfig"
osource "/Users/robbetiteca/projects/zephyr-workspace/zephyr/soc/qemu/hexagon/Kconfig"
osource "/Users/robbetiteca/projects/zephyr-workspace/zephyr/soc/openisa/rv32m1/Kconfig"
osource "/Users/robbetiteca/projects/zephyr-workspace/zephyr/soc/openhwgroup/cva6/Kconfig"
osource "/Users/robbetiteca/projects/zephyr-workspace/zephyr/soc/oct/osd32mp15x/Kconfig"
osource "/Users/robbetiteca/projects/zephyr-workspace/zephyr/soc/nxp/s32/Kconfig"
osource "/Users/robbetiteca/projects/zephyr-workspace/zephyr/soc/nxp/rw/Kconfig"
osource "/Users/robbetiteca/projects/zephyr-workspace/zephyr/soc/nxp/mcx/Kconfig"
osource "/Users/robbetiteca/projects/zephyr-workspace/zephyr/soc/nxp/lpc/Kconfig"
osource "/Users/robbetiteca/projects/zephyr-workspace/zephyr/soc/nxp/layerscape/Kconfig"
osource "/Users/robbetiteca/projects/zephyr-workspace/zephyr/soc/nxp/kinetis/Kconfig"
osource "/Users/robbetiteca/projects/zephyr-workspace/zephyr/soc/nxp/imxrt/Kconfig"
osource "/Users/robbetiteca/projects/zephyr-workspace/zephyr/soc/nxp/imx/Kconfig"
osource "/Users/robbetiteca/projects/zephyr-workspace/zephyr/soc/nuvoton/numicro/Kconfig"
osource "/Users/robbetiteca/projects/zephyr-workspace/zephyr/soc/nuvoton/numaker/Kconfig"
osource "/Users/robbetiteca/projects/zephyr-workspace/zephyr/soc/nuvoton/npcx/Kconfig"
osource "/Users/robbetiteca/projects/zephyr-workspace/zephyr/soc/nuvoton/npcm/Kconfig"
osource "/Users/robbetiteca/projects/zephyr-workspace/zephyr/soc/nordic/Kconfig"
osource "/Users/robbetiteca/projects/zephyr-workspace/zephyr/soc/neorv32/Kconfig"
osource "/Users/robbetiteca/projects/zephyr-workspace/zephyr/soc/native/inf_clock/Kconfig"
osource "/Users/robbetiteca/projects/zephyr-workspace/zephyr/soc/microchip/smartfusion2/Kconfig"
osource "/Users/robbetiteca/projects/zephyr-workspace/zephyr/soc/microchip/sam/sama7/Kconfig"
osource "/Users/robbetiteca/projects/zephyr-workspace/zephyr/soc/microchip/sam/sama5/Kconfig"
osource "/Users/robbetiteca/projects/zephyr-workspace/zephyr/soc/microchip/sam/sam_d5x_e5x/Kconfig"
osource "/Users/robbetiteca/projects/zephyr-workspace/zephyr/soc/microchip/pic64/Kconfig"
osource "/Users/robbetiteca/projects/zephyr-workspace/zephyr/soc/microchip/pic32c/pic32cz_ca/Kconfig"
osource "/Users/robbetiteca/projects/zephyr-workspace/zephyr/soc/microchip/pic32c/pic32cx_sg/Kconfig"
osource "/Users/robbetiteca/projects/zephyr-workspace/zephyr/soc/microchip/pic32c/pic32cm_sg_gc/Kconfig"
osource "/Users/robbetiteca/projects/zephyr-workspace/zephyr/soc/microchip/pic32c/pic32cm_pl/Kconfig"
osource "/Users/robbetiteca/projects/zephyr-workspace/zephyr/soc/microchip/pic32c/pic32cm_jh/Kconfig"
osource "/Users/robbetiteca/projects/zephyr-workspace/zephyr/soc/microchip/pic32c/pic32ck_sg_gc/Kconfig"
osource "/Users/robbetiteca/projects/zephyr-workspace/zephyr/soc/microchip/miv/Kconfig"
osource "/Users/robbetiteca/projects/zephyr-workspace/zephyr/soc/microchip/mec/Kconfig"
osource "/Users/robbetiteca/projects/zephyr-workspace/zephyr/soc/mediatek/mt8xxx/Kconfig"
osource "/Users/robbetiteca/projects/zephyr-workspace/zephyr/soc/lowrisc/opentitan/Kconfig"
osource "/Users/robbetiteca/projects/zephyr-workspace/zephyr/soc/litex/Kconfig"
osource "/Users/robbetiteca/projects/zephyr-workspace/zephyr/soc/ite/ec/Kconfig"
osource "/Users/robbetiteca/projects/zephyr-workspace/zephyr/soc/intel/wildcat_lake/Kconfig"
osource "/Users/robbetiteca/projects/zephyr-workspace/zephyr/soc/intel/raptor_lake/Kconfig"
osource "/Users/robbetiteca/projects/zephyr-workspace/zephyr/soc/intel/panther_lake/Kconfig"
osource "/Users/robbetiteca/projects/zephyr-workspace/zephyr/soc/intel/nova_lake/Kconfig"
osource "/Users/robbetiteca/projects/zephyr-workspace/zephyr/soc/intel/lakemont/Kconfig"
osource "/Users/robbetiteca/projects/zephyr-workspace/zephyr/soc/intel/intel_socfpga_std/Kconfig"
osource "/Users/robbetiteca/projects/zephyr-workspace/zephyr/soc/intel/intel_socfpga/Kconfig"
osource "/Users/robbetiteca/projects/zephyr-workspace/zephyr/soc/intel/intel_niosv/Kconfig"
osource "/Users/robbetiteca/projects/zephyr-workspace/zephyr/soc/intel/intel_ish/Kconfig"
osource "/Users/robbetiteca/projects/zephyr-workspace/zephyr/soc/intel/intel_adsp/Kconfig"
osource "/Users/robbetiteca/projects/zephyr-workspace/zephyr/soc/intel/elkhart_lake/Kconfig"
osource "/Users/robbetiteca/projects/zephyr-workspace/zephyr/soc/intel/atom/Kconfig"
osource "/Users/robbetiteca/projects/zephyr-workspace/zephyr/soc/intel/apollo_lake/Kconfig"
osource "/Users/robbetiteca/projects/zephyr-workspace/zephyr/soc/intel/alder_lake/Kconfig"
osource "/Users/robbetiteca/projects/zephyr-workspace/zephyr/soc/infineon/psoc4/Kconfig"
osource "/Users/robbetiteca/projects/zephyr-workspace/zephyr/soc/infineon/edge/Kconfig"
osource "/Users/robbetiteca/projects/zephyr-workspace/zephyr/soc/infineon/cat3/Kconfig"
osource "/Users/robbetiteca/projects/zephyr-workspace/zephyr/soc/infineon/cat1c/Kconfig"
osource "/Users/robbetiteca/projects/zephyr-workspace/zephyr/soc/infineon/cat1b/Kconfig"
osource "/Users/robbetiteca/projects/zephyr-workspace/zephyr/soc/infineon/cat1a/Kconfig"
osource "/Users/robbetiteca/projects/zephyr-workspace/zephyr/soc/gd/gd32/Kconfig"
osource "/Users/robbetiteca/projects/zephyr-workspace/zephyr/soc/gaisler/leon3/Kconfig"
osource "/Users/robbetiteca/projects/zephyr-workspace/zephyr/soc/gaisler/gr716a/Kconfig"
osource "/Users/robbetiteca/projects/zephyr-workspace/zephyr/soc/focaltech/Kconfig"
osource "/Users/robbetiteca/projects/zephyr-workspace/zephyr/soc/espressif/Kconfig"
osource "/Users/robbetiteca/projects/zephyr-workspace/zephyr/soc/ene/kb1200/Kconfig"
osource "/Users/robbetiteca/projects/zephyr-workspace/zephyr/soc/ene/kb106x/Kconfig"
osource "/Users/robbetiteca/projects/zephyr-workspace/zephyr/soc/elan/em32f967/Kconfig"
osource "/Users/robbetiteca/projects/zephyr-workspace/zephyr/soc/egis/Kconfig"
osource "/Users/robbetiteca/projects/zephyr-workspace/zephyr/soc/efinix/sapphire/Kconfig"
osource "/Users/robbetiteca/projects/zephyr-workspace/zephyr/soc/cdns/xtensa_sample_controller/Kconfig"
osource "/Users/robbetiteca/projects/zephyr-workspace/zephyr/soc/cdns/swerv/Kconfig"
osource "/Users/robbetiteca/projects/zephyr-workspace/zephyr/soc/cdns/sample_controller32/Kconfig"
osource "/Users/robbetiteca/projects/zephyr-workspace/zephyr/soc/cdns/dc233c/Kconfig"
osource "/Users/robbetiteca/projects/zephyr-workspace/zephyr/soc/cdac/Kconfig"
osource "/Users/robbetiteca/projects/zephyr-workspace/zephyr/soc/brcm/bcmvk/Kconfig"
osource "/Users/robbetiteca/projects/zephyr-workspace/zephyr/soc/brcm/bcm2712/Kconfig"
osource "/Users/robbetiteca/projects/zephyr-workspace/zephyr/soc/brcm/bcm2711/Kconfig"
osource "/Users/robbetiteca/projects/zephyr-workspace/zephyr/soc/brcm/bcm2710/Kconfig"
osource "/Users/robbetiteca/projects/zephyr-workspace/zephyr/soc/blackberry/qnxhv_vm/Kconfig"
osource "/Users/robbetiteca/projects/zephyr-workspace/zephyr/soc/bflb/Kconfig"
osource "/Users/robbetiteca/projects/zephyr-workspace/zephyr/soc/atmel/sam0/Kconfig"
osource "/Users/robbetiteca/projects/zephyr-workspace/zephyr/soc/atmel/sam/Kconfig"
osource "/Users/robbetiteca/projects/zephyr-workspace/zephyr/soc/aspeed/Kconfig"
osource "/Users/robbetiteca/projects/zephyr-workspace/zephyr/soc/arm/Kconfig"
osource "/Users/robbetiteca/projects/zephyr-workspace/zephyr/soc/antmicro/myra/Kconfig"
osource "/Users/robbetiteca/projects/zephyr-workspace/zephyr/soc/andestech/Kconfig"
osource "/Users/robbetiteca/projects/zephyr-workspace/zephyr/soc/amd/acp_7_x/Kconfig"
osource "/Users/robbetiteca/projects/zephyr-workspace/zephyr/soc/amd/acp_7_0/Kconfig"
osource "/Users/robbetiteca/projects/zephyr-workspace/zephyr/soc/amd/acp_6_0/Kconfig"
osource "/Users/robbetiteca/projects/zephyr-workspace/zephyr/soc/ambiq/Kconfig"
osource "/Users/robbetiteca/projects/zephyr-workspace/zephyr/soc/allwinner/sun8i_h3/Kconfig"
osource "/Users/robbetiteca/projects/zephyr-workspace/zephyr/soc/allwinner/sun50i_h618/Kconfig"
osource "/Users/robbetiteca/projects/zephyr-workspace/zephyr/soc/alif/ensemble/Kconfig"
osource "/Users/robbetiteca/projects/zephyr-workspace/zephyr/soc/alif/balletto/Kconfig"
osource "/Users/robbetiteca/projects/zephyr-workspace/zephyr/soc/aesc/Kconfig"
osource "/Users/robbetiteca/projects/zephyr-workspace/zephyr/soc/adi/max32/Kconfig"
```
